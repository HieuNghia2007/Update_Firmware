# file: Update_Firmware.ioc
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Mcu.Family=STM32F4
RCC.VCOOutputFreq_Value=192000000
RCC.APB2Freq_Value=16000000
RCC.CortexFreq_Value=16000000
PA14.Mode=Serial_Wire
PA13.Mode=Serial_Wire
Mcu.Name=STM32F407V(E-G)Tx
RCC.SYSCLKFreq_VALUE=16000000
Mcu.Package=LQFP100
ProjectManager.StackSize=0x400
PA13.Signal=SYS_JTMS-SWDIO
PA14.Signal=SYS_JTCK-SWCLK
ProjectManager.HeapSize=0x200
ProjectManager.TargetToolchain=STM32CubeIDE
RCC.HSI_VALUE=16000000
NVIC.PriorityGroup=NVIC_PRIORITYGROUP_4
RCC.LSE_VALUE=32768
RCC.APB1Freq_Value=16000000
RCC.AHBFreq_Value=16000000
RCC.HSE_VALUE=25000000
board=custom

// file: Core/Src/main.c
/* USER CODE BEGIN Header */
/**
  ******************************************************************************
  * @file           : main.c
  * @brief          : Main program body
  ******************************************************************************
  * @attention
  *
  * <h2><center>&copy; Copyright (c) 2022 STMicroelectronics.
  * All rights reserved.</center></h2>
  *
  * This software component is licensed by ST under BSD 3-Clause license,
  * the "License"; You may not use this file except in compliance with the
  * License. You may obtain a copy of the License at:
  *                        opensource.org/licenses/BSD-3-Clause
  *
  ******************************************************************************
  */
/* USER CODE END Header */
#include "main.h"

/* USER CODE BEGIN Includes */
#include "Mylib.h"
/* USER CODE END Includes */

/* USER CODE BEGIN PV */
char firmware[8192] = {0};
volatile char buffer[32] = {0};
int len_num = 0;
/* USER CODE END PV */

void SystemClock_Config(void);
static void MX_GPIO_Init(void);

/* USER CODE BEGIN 0 */

char msg1[] = "START PROGRAM\r\n";
char msg2[] = "Enter the size of the firmware according to the syntax: Firmware size:(byte)\r\n";
char msg3[] = "READY RECEIVE NEW FIRMWARE...\r\n";
char msg4[] = "Received the new firmware successfully\r\nUpdating and Rebooting...\r\n";
uint16_t* UART6_SR = (uint16_t*)(UART6_BASE_ADD + 0x00);
uint16_t* UART6_DR = (uint16_t*)(UART6_BASE_ADD + 0x04);
/* USER CODE END 0 */

int main(void)
{
  /* USER CODE BEGIN 1 */
	void Move_VectorTable_to_Ram()
	{
		memcpy((void*)0x20000000, (void*)0x08000000, 0x188);
		uint32_t* Vect_Tab = (uint32_t*)0xe000ed08;
		*Vect_Tab = 0x20000000;
	}
  /* USER CODE END 1 */

  /* MCU Configuration--------------------------------------------------------*/

  /* Reset of all peripherals, Initializes the Flash interface and the Systick. */
  HAL_Init();

  /* Configure the system clock */
  SystemClock_Config();

  /* Initialize all configured peripherals */
  MX_GPIO_Init();
  /* USER CODE BEGIN 2 */
  UART6_Init();
  UART6_Transmit(msg1, sizeof(msg1));
  UART6_Transmit(msg2, sizeof(msg2));
  UART6_Receive_DMA((uint32_t)UART6_DR, (uint32_t)buffer, (uint32_t)sizeof(buffer));
  char key_search[] = "Firmware size:";
  while(!strstr(buffer, key_search) || !strstr(buffer, "\r\n"));
  char* start_pos = strstr(buffer, key_search) + strlen(key_search);
  char len_str[16] = {0};
  int index = 0;
  while(start_pos[index] != '\r')
  {
	  len_str[index] = start_pos[index];
	  index++;
  }
  len_num = atoi(len_str);
  UART6_DMA_Stop();
  UART6_Receive_DMA_IT((uint32_t)UART6_DR, (uint32_t)firmware, len_num);
  UART6_Transmit(msg3, sizeof(msg3));
  //update();
  /* USER CODE END 2 */

  /* Infinite loop */
  while (1)
  {

  }
}

void SystemClock_Config(void)
{
  RCC_OscInitTypeDef RCC_OscInitStruct = {0};
  RCC_ClkInitTypeDef RCC_ClkInitStruct = {0};

  /** Configure the main internal regulator output voltage
  */
  __HAL_RCC_PWR_CLK_ENABLE();
  __HAL_PWR_VOLTAGESCALING_CONFIG(PWR_REGULATOR_VOLTAGE_SCALE1);
  /** Initializes the RCC Oscillators according to the specified parameters
  * in the RCC_OscInitTypeDef structure.
  */
  RCC_OscInitStruct.OscillatorType = RCC_OSCILLATORTYPE_HSI;
  RCC_OscInitStruct.HSIState = RCC_HSI_ON;
  RCC_OscInitStruct.HSICalibrationValue = RCC_HSICALIBRATION_DEFAULT;
  RCC_OscInitStruct.PLL.PLLState = RCC_PLL_NONE;
  if (HAL_RCC_OscConfig(&RCC_OscInitStruct) != HAL_OK)
  {
    Error_Handler();
  }
  /** Initializes the CPU, AHB and APB buses clocks
  */
  RCC_ClkInitStruct.ClockType = RCC_CLOCKTYPE_HCLK|RCC_CLOCKTYPE_SYSCLK
                              |RCC_CLOCKTYPE_PCLK1|RCC_CLOCKTYPE_PCLK2;
  RCC_ClkInitStruct.SYSCLKSource = RCC_SYSCLKSOURCE_HSI;
  RCC_ClkInitStruct.AHBCLKDivider = RCC_SYSCLK_DIV1;
  RCC_ClkInitStruct.APB1CLKDivider = RCC_HCLK_DIV1;
  RCC_ClkInitStruct.APB2CLKDivider = RCC_HCLK_DIV1;

  if (HAL_RCC_ClockConfig(&RCC_ClkInitStruct, FLASH_LATENCY_0) != HAL_OK)
  {
    Error_Handler();
  }
}

static void MX_GPIO_Init(void)
{

  /* GPIO Ports Clock Enable */
  __HAL_RCC_GPIOA_CLK_ENABLE();

}

/* USER CODE BEGIN 4 */
void DMA2_Stream2_IRQHandler()
{
	UART6_Transmit(msg4, sizeof(msg4));
	Update(len_num, firmware);
}
/* USER CODE END 4 */

void Error_Handler(void)
{
  __disable_irq();
  while (1)
  {
  }
}

/************************ (C) COPYRIGHT STMicroelectronics *****END OF FILE****/
